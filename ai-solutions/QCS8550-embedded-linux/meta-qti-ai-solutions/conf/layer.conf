## ai-solutions/QCS8550-embedded-linux/meta-qti-ai-solutions/conf/layer.conf
```bitbake
BBFILES += "${LAYERDIR}/recipes/*/*.bb ${LAYERDIR}/recipes/*/*.bbappend ${LAYERDIR}/recipes-*/*/*.bb ${LAYERDIR}/recipes-*/*/*.bbappend"
BBPATH .= ":${LAYERDIR}"
BBFILE_COLLECTIONS += "ai-solutions"
BBFILE_PRIORITY_ai-solutions = "17"
BBFILE_PATTERN_ai-solutions := "^${LAYERDIR}/"
LAYERSERIES_COMPAT_ai-solutions  = " dunfell kirkstone "
IMAGE_INSTALL:append = " ai-solutions "
```

## ai-solutions/QRB5165-embedded-linux/meta-qti-ai-solutions/conf/layer.conf
```bitbake
BBFILES += "${LAYERDIR}/recipes/*/*.bb ${LAYERDIR}/recipes/*/*.bbappend ${LAYERDIR}/recipes-*/*/*.bb ${LAYERDIR}/recipes-*/*/*.bbappend"
BBPATH .= ":${LAYERDIR}"
BBFILE_COLLECTIONS += "ai-solutions"
BBFILE_PRIORITY_ai-solutions = "17"
BBFILE_PATTERN_ai-solutions := "^${LAYERDIR}/"
IMAGE_INSTALL_append = " ai-solutions "
```
